## conf/machine/gbip4k.conf
```bitbake
#@TYPE: Machine
#@NAME: GigaBlue IP 4K
#@DESCRIPTION: Machine configuration for GigaBlue IP 4K

IMAGEDIR = "gigablue/ip4k"

require conf/machine/include/gigablue-mv200.inc

MACHINE_ESSENTIAL_EXTRA_RDEPENDS += "\
	enigma2-plugin-extensions-gbipboxclient \
	"
```

## conf/machine/gbipbox.conf
```bitbake
#@TYPE: Machine
#@NAME: GigaBlue IPBox
#@DESCRIPTION: Machine configuration for GigaBlue IPBox

IMAGEDIR = "gigablue/ipbox"

require conf/machine/include/gigablue-gb7358.inc

MACHINE_ESSENTIAL_EXTRA_RDEPENDS += "\
    enigma2-plugin-extensions-gbipboxclient \
"

MACHINE_FEATURES += "dvb-c"
```

## conf/machine/gbquad.conf
```bitbake
#@TYPE: Machine
#@NAME: GigaBlue Quad
#@DESCRIPTION: Machine configuration for GigaBlue Quad

IMAGEDIR = "gigablue/quad"

require conf/machine/include/gigablue-gb7356.inc

MACHINE_FEATURES += "colorlcd220 gigabluelcd220"

MACHINE_ESSENTIAL_EXTRA_RRECOMMENDS += "\
	kernel-module-smsc75xx \
	"
```

## conf/machine/gbquad4k.conf
```bitbake
#@TYPE: Machine
#@NAME: Gigablue Quad 4k
#@DESCRIPTION: Machine configuration for the Gigablue Quad 4k

IMAGEDIR ?= "gigablue/quad4k"

require conf/machine/include/gigablue-gb7252.inc
```

## conf/machine/gbtrio4k.conf
```bitbake
#@TYPE: Machine
#@NAME: GigaBlue Trio 4K
#@DESCRIPTION: Machine configuration for GigaBlue Trio 4K

IMAGEDIR = "gigablue/trio4k"

MACHINE_FEATURES += "ci"

require conf/machine/include/gigablue-mv200.inc

DISPLAY_MODEL = "UHD TRIO 4K"
```

## conf/machine/gbue4k.conf
```bitbake
#@TYPE: Machine
#@NAME: Gigablue UE 4k
#@DESCRIPTION: Machine configuration for the Gigablue UE 4k

IMAGEDIR ?= "gigablue/ue4k"

require conf/machine/include/gigablue-gb7252.inc
```

## conf/machine/include/gigablue-arm.inc
```bitbake
require conf/machine/include/gigablue.inc

TARGET_ARCH = "arm"
DEFAULTTUNE = "cortexa15hf-neon-vfpv4"
IMAGE_FSTYPES += "tar.bz2"

ROOTFS_FILE = "rootfs.tar.bz2"
MTD_KERNEL = "mmcblk0p4"
MTD_ROOTFS = "mmcblk0p5"
MTD_BOOTFS = "mmcblk0p1"
MTD_BLACK  = "mmcblk0"

require conf/machine/include/tune-cortexa15.inc

DVBMEDIASINK_CONFIG = "--with-wma --with-wmv --with-amr --with-pcm --with-dts --with-eac3 --with-h265 --with-vb6 --with-vb8 --with-vb9 --with-spark"

PREFERRED_PROVIDER_virtual/blindscan-dvbc = "gigablue-blindscan-utils-arm"
PREFERRED_PROVIDER_virtual/blindscan-dvbs = "gigablue-blindscan-utils-arm"

require conf/machine/include/soc-family.inc

MACHINE_FEATURES += "mmc emmc swap bluetooth mountboot dvb-c transcoding ci blindscan-dvbs blindscan-dvbc colorlcd gigabluelcd kodi19"

MACHINE_ESSENTIAL_EXTRA_RDEPENDS += "\
	${@bb.utils.contains('MACHINE_FEATURES', 'swap', 'gigablue-swapcreate', '',d)} \
	"

KERNELVERSION = "4.1.20"

PREFERRED_VERSION_linux-gigablue = "${KERNELVERSION}"
PREFERRED_PROVIDER_virtual/kernel = "linux-gigablue"
PREFERRED_PROVIDER_virtual/egl ?= "gb-v3ddriver-${STB_PLATFORM}"
PREFERRED_PROVIDER_virtual/libgles2 ?= "gb-v3ddriver-${STB_PLATFORM}"

MACHINE_ESSENTIAL_EXTRA_RDEPENDS += "\
	gb-v3ddriver-${STB_PLATFORM} \
	gigablue-platform-util-${STB_PLATFORM} \
	gigablue-ddbootup \
	gigablue-swapcreate \
	"

EXTRA_IMAGEDEPENDS += "\
	gigablue-initrd-cfe-${MACHINE} \
	"

IMAGE_INSTALL_append = " \
	bluetoothsetup-${STB_PLATFORM} \
	"
```

## conf/machine/include/gigablue-gb7252.inc
```bitbake
require conf/machine/include/gigablue-arm.inc

MACHINE_FEATURES += "quadpip bolt"

SOC_FAMILY = "bcm7252s"

SRCDATE_BOLT = "20181120"

IMAGE_CMD_tar_prepend = "\
	rm -Rf ${IMAGE_ROOTFS}/tmp/*; \
	mkdir -p ${DEPLOY_DIR_IMAGE}/${IMAGEDIR}; \
	cp -f ${DEPLOY_DIR_IMAGE}/${MACHINE}_boot.bin ${DEPLOY_DIR_IMAGE}/${IMAGEDIR}/boot.bin; \
	cp -f ${DEPLOY_DIR_IMAGE}/${MACHINE}_gpt.bin ${DEPLOY_DIR_IMAGE}/${IMAGEDIR}/gpt.bin; \
	cp -f ${DEPLOY_DIR_IMAGE}/${MACHINE}_rescue.bin ${DEPLOY_DIR_IMAGE}/${IMAGEDIR}/rescue.bin; \
	${@bb.utils.contains("MACHINE_FEATURES", "bolt", "cp -f ${DEPLOY_DIR_IMAGE}/${MACHINE}_bolt_${SRCDATE_BOLT}.bin ${DEPLOY_DIR_IMAGE}/${IMAGEDIR}/bolt_${SRCDATE_BOLT}.bin;" , "", d)} \
	cp -f ${DEPLOY_DIR_IMAGE}/zImage ${DEPLOY_DIR_IMAGE}/${IMAGEDIR}/${KERNEL_FILE}; \
	echo ${IMAGE_NAME} > ${DEPLOY_DIR_IMAGE}/${IMAGEDIR}/imageversion; \
	echo "https://forum.openvision.tech/app.php/donate" > ${DEPLOY_DIR_IMAGE}/${IMAGEDIR}/donate.txt; \
	cd ${IMAGE_ROOTFS}; \
	tar -cvf ${DEPLOY_DIR_IMAGE}/rootfs.tar -C ${IMAGE_ROOTFS} .; \
	mv -f ${DEPLOY_DIR_IMAGE}/rootfs.tar ${DEPLOY_DIR_IMAGE}/${IMAGEDIR}/rootfs.tar; \
	bzip2 ${DEPLOY_DIR_IMAGE}/${IMAGEDIR}/rootfs.tar; \
	cd ${DEPLOY_DIR_IMAGE}; \
	zip ${IMAGE_NAME}_usb.zip ${IMAGEDIR}/*; \
	rm -f ${DEPLOY_DIR_IMAGE}/*.tar.bz2; \
	rm -Rf gigablue; \
	"

STB_PLATFORM = "gb7252"

EXTRA_OECONF_append_pn-transtreamproxy = " --enable-ext-pid"
```

## conf/machine/include/gigablue-gb7325.inc
```bitbake
SOC_FAMILY = "bcm7325"

require gigablue-mips.inc

MACHINE_FEATURES += "blindscan-dvbc ci SCART YUV RCA"

PREFERRED_VERSION_linux-gigablue = "3.9.6"

MACHINE_ESSENTIAL_EXTRA_RDEPENDS += "\
    gigablue-dvb-modules-gb7325 \
"

DVBMEDIASINK_CONFIG = "--with-wmv"

GLIBC_EXTRA_OECONF = "--with-tls"

STB_PLATFORM = "gb7325"
```

## conf/machine/include/gigablue-mv200.inc
```bitbake
require conf/machine/include/gigablue-oem.inc

KERNELVERSION = "4.4.35"

MTD_KERNEL = "mmcblk0p12"
MTD_ROOTFS = "mmcblk0p16"
MTD_BLACK  = "mmcblk0"

ROOTFS_FILE = "rootfs.tar.bz2"

DISTRO_FEATURES_remove += "x11 wayland"

SOC_FAMILY = "hisi3798mv200"
HICHIPSET = "3798mv200"
CHIPSET = "Hi3798Mv200"

MACHINE_ESSENTIAL_EXTRA_RDEPENDS += "\
	gigablue-dvb-modules-${MACHINE} \
	gigablue-loadmodules-${STB_PLATFORM} \
	gigablue-opengl-${STB_PLATFORM} \
	gigablue-libs-${STB_PLATFORM} \
	gigablue-hihalt-${STB_PLATFORM} \
	gigablue-reader-${MACHINE} \
	gigablue-partitions-${MACHINE} \
	gigablue-libreader-${STB_PLATFORM} \
	gigablue-buildimage \
	e2fsprogs-resize2fs \
	gptfdisk \
	${@bb.utils.contains('MACHINE_FEATURES', 'emmc', 'partitions-by-name' , '', d)} \
	"

MACHINE_FEATURES += "switchoff 7segment hdmicec textlcd emmc mmc blindscan-dvbs alsa hisil multitranscoding vfdsymbol kodi19"

IMAGE_CLASSES  += "gigablue-emmc_image"
IMAGE_FSTYPES += "gigablueemmc"
IMAGE_ROOTFS_SIZE ?= "524288"

TARGET_ARCH = "arm"
DEFAULTTUNE = "cortexa15hf-neon-vfpv4"

PREFERRED_VERSION_linux-gigablue = "${KERNELVERSION}"
PREFERRED_PROVIDER_virtual/egl ?= "gigablue-opengl-${STB_PLATFORM}" 
PREFERRED_PROVIDER_virtual/libgles1 ?= "gigablue-opengl-${STB_PLATFORM}"
PREFERRED_PROVIDER_virtual/libgles2 ?= "gigablue-opengl-${STB_PLATFORM}"
PREFERRED_PROVIDER_virtual/blindscan-dvbs = "gigablue-blindscan-${STB_PLATFORM}"
PREFERRED_RPROVIDER_showiframe = "gigablue-showiframe-${STB_PLATFORM}"
PREFERRED_RPROVIDER_aio-grab = "gigablue-grab-${STB_PLATFORM}"
PREFERRED_PROVIDER_virtual/enigma2-mediaservice = "enigma2-plugin-systemplugins-servicehisilicon"

require conf/machine/include/tune-cortexa15.inc


DVBMEDIASINK_CONFIG = "--with-h265 --with-vb8 --with-vb9 --with-spark --with-wma --with-wmv --with-pcm --with-dts --with-eac3"

EXTRA_OECONF_append_pn-enigma2 = "--with-lcddev=/dev/null --with-alphablendingacceleration=always --with-blitaccelerationthreshold=250  --with-fillaccelerationthreshold=190000"

IMAGE_CMD_gigablueemmc_append = " \
	mkdir -p ${DEPLOY_DIR_IMAGE}/${IMAGEDIR}; \
	mv -f ${IMGDEPLOYDIR}/${IMAGE_NAME}${IMAGE_NAME_SUFFIX}.ext4 ${DEPLOY_DIR_IMAGE}/${MACHINE}-partitions/rootfs.ext4; \
	cd ${IMAGE_ROOTFS}; \
	tar -cvf ${DEPLOY_DIR_IMAGE}/rootfs.tar -C ${IMAGE_ROOTFS} .; \
	mv -f ${DEPLOY_DIR_IMAGE}/rootfs.tar ${DEPLOY_DIR_IMAGE}/${IMAGEDIR}/rootfs.tar; \
	bzip2 ${DEPLOY_DIR_IMAGE}/${IMAGEDIR}/rootfs.tar; \
	cp -f ${DEPLOY_DIR_IMAGE}/uImage ${DEPLOY_DIR_IMAGE}/${IMAGEDIR}/${KERNEL_FILE}; \
	cp -f ${DEPLOY_DIR_IMAGE}/uImage ${DEPLOY_DIR_IMAGE}/${MACHINE}-partitions/${KERNEL_FILE}; \
	echo ${IMAGE_NAME} > ${DEPLOY_DIR_IMAGE}/${IMAGEDIR}/imageversion; \
	echo "https://forum.openvision.tech/app.php/donate" > ${DEPLOY_DIR_IMAGE}/${IMAGEDIR}/donate.txt; \
	cd ${DEPLOY_DIR_IMAGE}/${MACHINE}-partitions; \
	mkupdate -s 00000003-00000001-01010101 -f ${DEPLOY_DIR_IMAGE}/${MACHINE}-partitions/emmc_partitions.xml -d ${DEPLOY_DIR_IMAGE}/usb_update.bin; \
	rm -f ${DEPLOY_DIR_IMAGE}/*.zip; \
	cd ${DEPLOY_DIR_IMAGE}; \
	cp -f ${IMGDEPLOYDIR}/${IMAGE_NAME}${IMAGE_NAME_SUFFIX}.manifest ${IMAGE_NAME}_usb.zip.manifest; \
	zip -j ${IMAGE_NAME}_recovery_emmc.zip ${DEPLOY_DIR_IMAGE}/usb_update.bin ${DEPLOY_DIR_IMAGE}/${IMAGEDIR}/imageversion ${DEPLOY_DIR_IMAGE}/${IMAGEDIR}/donate.txt ${DEPLOY_DIR_IMAGE}/${MACHINE}-partitions/bootargs.bin ${DEPLOY_DIR_IMAGE}/${MACHINE}-partitions/fastboot.bin ${DEPLOY_DIR_IMAGE}/${MACHINE}-partitions/apploader.bin; \
	zip ${IMAGE_NAME}_usb.zip ${IMAGEDIR}/*; \
	rm -f ${DEPLOY_DIR_IMAGE}/*.ext4; \
	rm -f ${DEPLOY_DIR_IMAGE}/usb_update.bin; \
	rm -Rf ${IMAGEDIR}; \
	rm -Rf gigablue; \
	rm -Rf userdata; \
	rm -Rf ${MACHINE}-partitions; \
	"

IMAGE_CMD_prepend = "\
	rm -Rf ${IMAGE_ROOTFS}/tmp/*; \
	rm -Rf ${DEPLOY_DIR_IMAGE}/userdata; \
	"

STB_PLATFORM = "gbmv200"

EXTRA_ALSA = "mv200"

RCNAME = "gb3"
```

## conf/machine/include/gigablue-oem.inc
```bitbake
# We know about rtc
MACHINE_FEATURES_BACKFILL_CONSIDERED += "rtc"

BOX_BRAND = "gigablue"

KERNEL_FILE = "kernel.bin"

MACHINE_ESSENTIAL_EXTRA_RDEPENDS += "\
	gigablue-ddbootup \
	enigma2-plugin-systemplugins-vfdcontrol \
	kernel-module-rtl8192cu \
	firmware-rtl8192cu \
	firmware-rtl8192cufw \
	kernel-module-extrawlan-rtl8192eu \
	firmware-rtl8192eu \
	kernel-module-extrawlan-rt8812au \
	kernel-module-extrawlan-rt8822bu \
	"

DVBPROVIDER = "kernel"

MACHINE_ESSENTIAL_EXTRA_RRECOMMENDS += "\
	kernel-module-zram \
	kernel-module-autofs4 \
	"

MACHINE_EXTRA_RRECOMMENDS += "\
	gstreamer1.0-plugin-dvbmediasink \
	${@bb.utils.contains("MACHINE_FEATURES", "hisi", "" , "gigablue-cfe", d)} \
	"

KERNEL_MODULE_AUTOLOAD += "\
	autofs4 \
	xfs \
	"

PREFERRED_PROVIDER_virtual/kernel = "linux-gigablue"

KERNEL_OUTPUT = "${KERNEL_IMAGETYPE}"
KERNEL_CONSOLE = "ttyS0,115200n8"

MACHINE_FEATURES += "3dtv alsa hdmicec switchoff blindscan-tbs gigablue"

BOOTLOGO_FILENAME = "splash.bin"

require conf/machine/include/soc-family.inc
```

## conf/machine/include/gigablue.inc
```bitbake
# We know about rtc
MACHINE_FEATURES_BACKFILL_CONSIDERED += "rtc"

MACHINE_FEATURES += "alsa hdmicec switchoff gigablue blindscan-tbs HDMI"

BOX_BRAND = "gigablue"
```
